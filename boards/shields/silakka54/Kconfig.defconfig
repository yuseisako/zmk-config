## boards/shields/silakka54/Kconfig.defconfig
```kconfig
if SHIELD_SILAKKA54_LEFT

config ZMK_KEYBOARD_NAME
    default "Silakka54"

config ZMK_SPLIT_ROLE_CENTRAL
    default y

endif

if SHIELD_SILAKKA54_LEFT || SHIELD_SILAKKA54_RIGHT || SHIELD_SILAKKA54_LEFT_PERIPHERAL

config ZMK_SPLIT
    default y
endif
```
