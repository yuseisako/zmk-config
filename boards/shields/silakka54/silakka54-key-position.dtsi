/ {
    silakka54_layout: silakka54_layout {
        compatible = "zmk,keyboard-layout";

        /*
         * CLEAN GRID LAYOUT — 19 mm spacing
         * Left half origin: (0,0)
         * Right half origin: (140,0)
         *
         * 6 columns × 4 rows per side
         * Thumb clusters beneath row 3:
         *   Left:  RC(4,1) RC(4,2) RC(4,3)
         *   Right: RC(4,8) RC(4,9) RC(4,10)
         */

        key-positions = <
            /* Row 0 — Left half (cols 0–5) */
             0   0
            19   0
            38   0
            57   0
            76   0
            95   0

            /* Row 0 — Right half (cols 6–11) */
            140   0
            159   0
            178   0
            197   0
            216   0
            235   0

            /* Row 1 — Left */
             0   19
            19   19
            38   19
            57   19
            76   19
            95   19

            /* Row 1 — Right */
            140   19
            159   19
            178   19
            197   19
            216   19
            235   19

            /* Row 2 — Left */
             0   38
            19   38
            38   38
            57   38
            76   38
            95   38

            /* Row 2 — Right */
            140   38
            159   38
            178   38
            197   38
            216   38
            235   38

            /* Row 3 — Left */
             0   57
            19   57
            38   57
            57   57
            76   57
            95   57

            /* Row 3 — Right */
            140   57
            159   57
            178   57
            197   57
            216   57
            235   57

            /* Row 4 — Left thumb cluster (cols 1–3) */
            19   80
            38   80
            57   80

            /* Row 4 — Right thumb cluster (cols 8–10) */
            159   80
            178   80
            197   80
        >;
    };
};